## boards/shields/endgame/Kconfig.defconfig
```kconfig
if SHIELD_ENDGAME

# Name must be less than 16 characters long!
config ZMK_KEYBOARD_NAME
    default "Endgame2024"

endif
```

## boards/shields/endgame/Kconfig.shield
```kconfig
# No whitespace after the comma or in your keyboard name!
config SHIELD_ENDGAME
    def_bool $(shields_list_contains,endgame)
```
